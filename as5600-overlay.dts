/dts-v1/;
/plugin/;

/ {
	fragment@0 {
		target = <&i2c1>;

		__overlay__ {
			status = "okay";

			#address-cells = <1>;
			#size-cells = <0>;

			as5600@36 {
				compatible = "infineon,as5600";
				reg = <0x36>;
				status = "okay";
			};
		};
	};
};
